## CMakeLists.txt
```
# SPDX-License-Identifier: Apache-2.0

cmake_minimum_required(VERSION 3.20.0)

find_package(Zephyr REQUIRED HINTS $ENV{ZEPHYR_BASE})
project(hello_world)

target_sources(app PRIVATE src/main.c src/flash_handler.c src/bao_config.c src/mocktee.c)

# Include the fsl_puf driver in HAL_NXP
set(PUF_path $ENV{ZEPHYR_BASE}/../modules/hal/nxp/mcux/mcux-sdk/drivers/puf)
zephyr_sources(${PUF_path}/fsl_puf.c)
zephyr_include_directories(${PUF_path})
```

## west.yml
```
manifest:
  remotes:
    - name: zephyrproject-rtos-fork
      url-base: https://github.com/tym2k1
  projects:
    - name: zephyr
      remote: zephyrproject-rtos-fork
      revision: UC1_1_VM_GUEST
      import: true
  self:
    path: application
```

## prj.conf
```kconfig
CONFIG_MAIN_STACK_SIZE=8192
CONFIG_FLASH_MAP=y
CONFIG_FLASH=y
CONFIG_PRINTK=y
CONFIG_CONSOLE=y
CONFIG_STDOUT_CONSOLE=y
CONFIG_UART_CONSOLE=y
CONFIG_MBEDTLS=y
CONFIG_MBEDTLS_BUILTIN=y
CONFIG_MBEDTLS_ENABLE_HEAP=y
CONFIG_MBEDTLS_SHA256=y
CONFIG_MBEDTLS_ENTROPY_C=y

CONFIG_MBEDTLS_CTR_DRBG_ENABLED=y

CONFIG_ENTROPY_GENERATOR=y

CONFIG_MBEDTLS_ECP_C=y
CONFIG_MBEDTLS_ECP_DP_SECP256R1_ENABLED=y
CONFIG_MBEDTLS_ECP_NIST_OPTIM=y   
```

## src/main.c
```c
#include <stdio.h>
#include "bao_config.h"
#include <zephyr/drivers/tee.h>
#include <zephyr/kernel.h>

#define TIMER_IRQ_ID        15

void shmem_init(void)
{
    memset(message[0], 0, MESSAGE0_SIZE);
    memset(message[1], 0, MESSAGE1_SIZE);
}

void tee_function1(void)
{
    static const uint8_t uuid[TEE_UUID_LEN] = {
        0x00, 0x11, 0x22, 0x33,   /* timeLow    */
        0x44, 0x55,               /* timeMid    */
        0x66, 0x77,               /* timeHi+ver */
        0x88, 0x99, 0xAA, 0xBB,   /* clockSeq   */
        0xCC, 0xDD, 0xEE, 0xFF    /* node       */
    };
    printf(VM": Calling func 1\n");
    memcpy((void*)message[0], &uuid, sizeof(uuid));
    ipc_notify(0,0);
};

void tee_function2(void)
{
    static const uint8_t uuid[TEE_UUID_LEN] = {
        0x11, 0x22, 0x33, 0x44,   /* timeLow    */
        0x55, 0x66,               /* timeMid    */
        0x77, 0x88,               /* timeHi+ver */
        0x99, 0xAA, 0xBB, 0xCC,   /* clockSeq   */
        0xDD, 0xEE, 0xFF, 0x00    /* node       */
    };
    printf(VM": Calling func 1\n");
    memcpy((void*)message[0], &uuid, sizeof(uuid));
    ipc_notify(0,0);
};

void tee_function3(void)
{
    static const uint8_t uuid[TEE_UUID_LEN] = {
        0x22, 0x33, 0x44, 0x55,   /* timeLow    */
        0x66, 0x77,               /* timeMid    */
        0x88, 0x99,               /* timeHi+ver */
        0xAA, 0xBB, 0xCC, 0xDD,   /* clockSeq   */
        0xEE, 0xFF, 0x00, 0x11    /* node       */
    };
    printf(VM": Calling func 1\n");
    memcpy((void*)message[0], &uuid, sizeof(uuid));
    ipc_notify(0,0);
};

void timer_irq_handler(void)
{
    static uint32_t counter = 0;
    if(counter==5){
        tee_function1();
        counter += 1;
    }
    else if(counter==10){
        tee_function2();
        counter += 1;
    }
    else if(counter==15){
        tee_function3();
        counter += 1;
    }
    else if(counter>15){
        printf(VM": Resetting counter\n");
        counter = 0;
    }
    else{
        printf(VM": Waiting\n");
        counter += 1;
    };
}

static void _zephyr_timer_cb(struct k_timer *t) {
    timer_irq_handler();
}

/* Define a 100 ms periodic k_timer */
K_TIMER_DEFINE(_zephyr_timer, _zephyr_timer_cb, NULL);

int main(void)
{
    printf(VM": Guest VM Initialized\n");

    const struct device *tee_dev = device_get_binding("mocktee");
    struct tee_version_info info;
    int res = tee_get_version(tee_dev, &info);
    if (res == 0) {
        printf("TEE version info:\n");
        printf("  impl_id   = %u\n", info.impl_id);
        printf("  impl_caps = 0x%08x\n", info.impl_caps);
        printf("  gen_caps  = 0x%08x\n", info.gen_caps);
    } else {
        printf("tee_get_version() failed: %d\n", res);
    }

    shmem_init();

    IRQ_CONNECT(IPC_IRQ_ID, 0, ipc_irq_handler, NULL, 0);
    irq_enable(IPC_IRQ_ID);

    k_timer_start(&_zephyr_timer, K_MSEC(100), K_MSEC(100));

    for (;;) {
        k_sleep(K_FOREVER);
    }
}
```

## src/bao_config.c
```c
#include "bao_config.h"
#include <stdio.h>
#include <string.h>

void (*bao_hypercall)(unsigned int, unsigned int, unsigned int) =
    (void (*)(unsigned int, unsigned int, unsigned int))BAO_HC_ADDR;

void print_hex(const char* label, const void* data, size_t len) {
    const uint8_t* bytes = (const uint8_t*)data;
    printf("%s: ", label);
    for (size_t i = 0; i < len; ++i) {
        printf("%02X", bytes[i]);
        if (i < len - 1) printf(":");
    }
    printf("\r\n");
}

void ipc_notify(int ipc_id, int event_id)
{
    bao_hypercall(BAO_HC_IPC_ID, ipc_id, event_id);
}

void ipc_irq_handler(void)
{
    printf(VM": IPC Handler\n");
    print_hex("Return Code:", message[1], MESSAGE1_SIZE);
}
```

## src/bao_config.h
```c
#include <string.h>
#include <stdint.h>
#include <zephyr/irq.h>
#include <cmsis_core.h>

#define VM                  "VM0"
#define IPC_IRQ_ID          62      //78 on Bao config
#define BAO_IMAGE_START     0x10000000UL
#define BAO_HC_OFF          0x41UL
#define BAO_HC_ADDR         ((uintptr_t)BAO_IMAGE_START + BAO_HC_OFF)
#define BAO_HC_IPC_ID       0x1
#define VMS_IPC_BASE        0x20017000UL
#define VMS_IPC_SIZE        0x1000

/* Define shared memory layout */
#define MESSAGE0_SIZE       ((const size_t)(0x10)) //128-bit/16-byte - place for TEE Calls UUID
#define MESSAGE0_OFFSET     VMS_IPC_BASE

#define MESSAGE1_SIZE       ((const size_t)(0x4))  //32-bit/4-byte - place for TEEC_Result
#define MESSAGE1_OFFSET     MESSAGE0_OFFSET + MESSAGE0_SIZE

#define MESSAGE2_SIZE       ((const size_t)(VMS_IPC_SIZE - MESSAGE0_SIZE - MESSAGE1_SIZE)) //Ugly, WIP
#define MESSAGE2_OFFSET     MESSAGE1_OFFSET + MESSAGE1_SIZE

static char* const message[3] = {
    (const char*)(MESSAGE0_OFFSET),
    (const char*)(MESSAGE1_OFFSET),
    (const char*)(MESSAGE2_OFFSET),
};

extern void (*bao_hypercall)(unsigned int, unsigned int, unsigned int);

void ipc_notify(int ipc_id, int event_id);
void ipc_irq_handler(void);
```

## src/flash_handler.h
```c
#include <zephyr/drivers/flash.h>
#include <zephyr/storage/flash_map.h>

/* Flash configuration macros, specific to
 * platform/use-case. These were based
 * on the LPC55S69 board */

#ifndef FLASH_WRITE_SIZE
#define FLASH_WRITE_SIZE  0x200 /* 512 bytes as per DTS */
#endif
#ifndef PARTITION_OFFSET
#define PARTITION_OFFSET  0     /* Offset within the partition */
#endif
#ifndef STORAGE_PARTITION
#define STORAGE_PARTITION storage_partition
#endif

#ifndef PUF_KEY_SIZE
#define PUF_KEY_SIZE 32         /* Multiples of 8, larger than kPUF_KeySizeM (8), less than kPUF_KeySizeMax (512) */
#endif

#ifndef PUF_KEY_CODE_SIZE
#define PUF_KEY_CODE_SIZE PUF_GET_KEY_CODE_SIZE_FOR_KEY_SIZE(PUF_KEY_SIZE)
#endif

/* Define flash layout offsets within the partition */
#define FLASH_OFFSET_ACTIVATION_CODE (PARTITION_OFFSET + 0)
#define FLASH_SIZE_ACTIVATION_CODE   ALIGN_UP(PUF_ACTIVATION_CODE_SIZE, FLASH_WRITE_SIZE)

#define FLASH_OFFSET_INTRINSIC_KEY_1_KC (FLASH_OFFSET_ACTIVATION_CODE + FLASH_SIZE_ACTIVATION_CODE)
#define FLASH_SIZE_INTRINSIC_KEY_1_KC   ALIGN_UP(PUF_KEY_CODE_SIZE, FLASH_WRITE_SIZE)

#define FLASH_OFFSET_INTRINSIC_KEY_2_KC (FLASH_OFFSET_INTRINSIC_KEY_1_KC + FLASH_SIZE_INTRINSIC_KEY_1_KC)
#define FLASH_SIZE_INTRINSIC_KEY_2_KC   ALIGN_UP(PUF_KEY_CODE_SIZE, FLASH_WRITE_SIZE)

/* Later additional variables can be tracked as needed, for example:
 * #define FLASH_OFFSET_ADDITIONAL_VAR (FLASH_OFFSET_ACTIVATION_CODE + FLASH_SIZE_ACTIVATION_CODE)
 * #define FLASH_SIZE_ADDITIONAL_VAR   0x400
 */

/* Macro to align size up to the next multiple of 'align' */
#define ALIGN_UP(x, align) (((x) + (align) - 1) & ~((align) - 1))

/**
 * @brief Initializes the flash area and returns the flash device pointer.
 *
 * @param partition_id   Identifier for the flash partition.
 * @param flash_area_out Pointer to the flash_area pointer to be filled.
 * @param flash_dev_out  Pointer to the flash device pointer to be filled.
 *
 * @return 0 on success, -1 on error.
 */
int flash_initialize(uint32_t partition_id, const struct flash_area **flash_area_out, const struct device **flash_dev_out);

/**
 * @brief Writes data to flash with page-size alignment.
 *
 * @param flash_dev       Pointer to the flash device.
 * @param flash_area      Pointer to the flash area structure.
 * @param data_offset     Data starting point offset within the partition.
 * @param data            Pointer to the data to be written.
 * @param data_size       Size of the data.
 *
 * @return 0 on success, -1 on error.
 */
int flash_write_padded(const struct device *flash_dev, const struct flash_area *flash_area, off_t data_offset,
                       const uint8_t *data, size_t data_size);

/**
 * @brief Reads data from flash into a provided buffer.
 *
 * @param flash_dev       Pointer to the flash device.
 * @param flash_area      Pointer to the flash area structure.
 * @param data_offset     Data starting point offset within the partition.
 * @param buffer          Destination buffer for read data.
 * @param data_size       Size of the data to read.
 *
 * @return 0 on success, -1 on error.
 */
int flash_read_data(const struct device *flash_dev, const struct flash_area *flash_area, off_t data_offset,
                    uint8_t *buffer, size_t data_size);
```

## src/mocktee.c
```c
#include <zephyr/drivers/tee.h>

#define TEE_IMPL_ID 1

int tee_add_shm(const struct device *dev, void *addr, size_t align, size_t size,
		uint32_t flags, struct tee_shm **shmp)
{
    return 0;
};


int tee_rm_shm(const struct device *dev, struct tee_shm *shm)
{
    return 0;
};

static int mocktee_get_version(const struct device *dev, struct tee_version_info *info)
{
	if (!info) {
		return -EINVAL;
	}

	info->impl_id = TEE_IMPL_ID;
	info->impl_caps = NULL;

        /* Definitions in zephyr/drivers/tee.h
         *
         * TEE_GEN_CAP_GP - GlobalPlatform compliant TEE
         * Not supported yet
         *
         * TEE_GEN_CAP_PRIVILEGED - Privileged device (for supplicant)
         * Not relevant as we dont use privileged/unprivileged context
         *
         * TEE_GEN_CAP_REG_MEM - Supports registering shared memory
         * Non-supported, Shared memory is set statically at compile time by hypervisor
         *
         * TEE_GEN_CAP_MEMREF_NULL - Support NULL MemRef
         * TBD
         * This flag declares that TEE supports “NULL MemRef” parameters—that is,
         * when a Trusted Application (TA) is invoked it may legitimately see a
         * memref parameter whose buffer pointer is NULL.
         * Not all TEE implementations honor this: some will reject any NULL buffer with an error.
         *
         * */
	info->gen_caps = NULL;

	return 0;
}

static const struct tee_driver_api mocktee_api = {
    .get_version   = mocktee_get_version,
    .open_session  = tee_open_session,
    .close_session = tee_close_session,
    .cancel        = tee_cancel,
    .invoke_func   = tee_invoke_func,
    .shm_register  = tee_shm_register,
    .shm_unregister= tee_shm_unregister,
    .suppl_recv    = tee_suppl_recv,
    .suppl_send    = tee_suppl_send,
};

DEVICE_DEFINE(mocktee,                    /* C symbol for your device */
              "mocktee",                  /* the string name used by device_get_binding() */
              NULL,                       /* init function */
              NULL,                       /* pm_control (optional) */
              NULL,                       /* driver data (struct, if you need) */
              NULL,                       /* driver config (if any) */
              POST_KERNEL,                /* init level: when in boot-up */
              CONFIG_KERNEL_INIT_PRIORITY_DEVICE,
              &mocktee_api);              /* pointer to your tee_driver_api */
```

## src/puf_prover.c
```c
#include <stdio.h>
#include "puf_prover.h"
#include "flash_handler.h"
#include "mbedtls/bignum.h"
#include "mbedtls/sha256.h"
#include "mbedtls/ctr_drbg.h"
#include "mbedtls/entropy.h"
#include "mbedtls/ecp.h"
#include <stddef.h>
#include "utils.h"


int initialize_and_start_puf(PUF_Type *puf,puf_config_t pufConfig,
                          uint8_t *activation_code,
                          size_t activation_code_size,
                          const struct flash_area *flash_area,
                          const struct device *flash_dev,
                          bool writeToFlash){
    status_t status;
    int ret;

    /* Get default configuration and initialize the provided PUF instance */
    PUF_GetDefaultConfig(&pufConfig);
    status = PUF_Init(puf, &pufConfig);
    if (status != kStatus_Success) {
        printf("Error: PUF initialization failed!\r\n");
        return -1;
    }
    printf("PUF Initialized Successfully.\r\n");

    if (writeToFlash) {
        /* Enroll and generate the activation code */
        memset(activation_code, 0, activation_code_size);
        status = PUF_Enroll(puf, activation_code, activation_code_size);
        if (status != kStatus_Success) {
            printf("Error: PUF enrollment failed!\r\n");
            flash_area_close(flash_area);
            return -1;
        }
        printf("PUF Enroll successful. Activation Code created.\r\n");

        /* Write the activation code to flash with padding */
        ret = flash_write_padded(flash_dev, flash_area, FLASH_OFFSET_ACTIVATION_CODE,
                                 activation_code, activation_code_size);
        if (ret != 0) {
            flash_area_close(flash_area);
            return -1;
        }
        printf("Activation code saved in flash.\r\n");

        /* Reinitialize PUF after enrollment */
        PUF_Deinit(puf, &pufConfig);
        PUF_Init(puf, &pufConfig);
        printf("PUF Reinitialized after enrollment.\r\n");
    } else {
        /* Read the activation code from flash */
        ret = flash_read_data(flash_dev, flash_area, FLASH_OFFSET_ACTIVATION_CODE,
                              activation_code, activation_code_size);
        if (ret != 0) {
            flash_area_close(flash_area);
            return -1;
        }
        printf("Activation code read from flash.\r\n");
    }

    /* Start the PUF with the activation code */
    status = PUF_Start(puf, activation_code, activation_code_size);
    if (status != kStatus_Success) {
        printf("Error: PUF start failed!\r\n");
        return -1;
    }
    printf("PUF Started successfully.\r\n");

    return 0;
}


int get_puf_key(PUF_Type *puf,
                          uint8_t *activation_code,
                          size_t activation_code_size,
                          const struct flash_area *flash_area,
                          const struct device *flash_dev,
                          bool writeToFlash,
                          uint8_t *outputBuffer)
{
    
    uint8_t keyCode[PUF_KEY_CODE_SIZE] = {0};
    uint8_t intrinsicKey[PUF_KEY_SIZE] = {0};
    int ret;
    
    if (writeToFlash) {

        ret = PUF_SetIntrinsicKey(PUF, kPUF_KeyIndex_01, PUF_KEY_SIZE, keyCode, sizeof(keyCode));
        if (ret != 0) {
            printf("PUF Intrinsic key 1 generation failed!\r\n");
            return ret;
        }

        ret = flash_write_padded(flash_dev, flash_area, FLASH_OFFSET_INTRINSIC_KEY_1_KC,
                                 keyCode, PUF_KEY_CODE_SIZE);
        if (ret != 0) {
            printf("PUF Intrinsic key 1 KC saving to flash failed!\r\n");
            return ret;

        }
    } else {
        ret = flash_read_data(flash_dev, flash_area, FLASH_OFFSET_INTRINSIC_KEY_1_KC ,
                              keyCode, PUF_KEY_CODE_SIZE);
        if (ret != 0) {
            flash_area_close(flash_area);
            return -1;
        }
        printf("Intrinsic key code read from flash.\r\n");
    }

    /* Reconstruct intrinsic key from keyCode1 generated by PUF_SetIntrinsicKey() */
    ret = PUF_GetKey(PUF, keyCode, sizeof(keyCode), intrinsicKey, sizeof(intrinsicKey));
    if (ret != kStatus_Success)
    {
        printf("Error reconstructing intrinsic key!\r\n");
    }

    if (outputBuffer != NULL) {
        memcpy(outputBuffer, intrinsicKey, PUF_KEY_SIZE);
    }
    
    flash_area_close(flash_area);

    return 0;
}

void puf_deinit(PUF_Type *puf,puf_config_t pufConfig){
    PUF_Deinit(puf, &pufConfig);
}



int get_response_to_challenge(const uint8_t *c, size_t c_size, mbedtls_mpi *r, PUF_Type *puf,
                          uint8_t *activation_code,
                          size_t activation_code_size,
                          const struct flash_area *flash_area,
                          const struct device *flash_dev,
                          bool writeToFlash
                          ){
    
    int ret;
    uint8_t keysize = PUF_KEY_SIZE;
    uint8_t *key = malloc(keysize);
    uint8_t *hashOutput = malloc(keysize);

    ret = get_puf_key(puf,activation_code,activation_code_size,
                          flash_area,flash_dev,
                          writeToFlash,
                          key);

    if(ret!=0){
        printf("Error While Getting Response From PUF");
        return ret;
    }

    uint8_t combined[c_size + keysize];

    // Combine keyCode and challenge
    memcpy(combined, key, keysize);
    memcpy(combined + keysize, c, c_size);
   
    // Hash the combined data
    mbedtls_sha256(combined, sizeof(combined), hashOutput, 0);
    

    if (mbedtls_mpi_read_binary(r, hashOutput, PUF_KEY_SIZE) != 0) {
        free(hashOutput);
        free(key);
    	return 1;
    }

    free(hashOutput);
    free(key);

    return 0;
}


int init_ECC(mbedtls_ecp_group *grp, mbedtls_ecp_point *h, mbedtls_ecp_point *C ){
    mbedtls_ecp_group_init(grp);
	mbedtls_ecp_point_init(h);
	mbedtls_ecp_point_init(C);
	int res;
	res = mbedtls_ecp_group_load(grp, MBEDTLS_ECP_DP_SECP256R1);

    if (res != 0) {
        printf("Failed to load EC group: -0x%04X\n", -res);
        return 1;
    }
    
    mbedtls_mpi x;
	mbedtls_mpi_init(&x);
	res = mbedtls_mpi_lset(&x, CONSTANT_FOR_H_GENERATOR);  
	
     if (res != 0) {
        printf("Failed to set X");
        return 1;
    }
    
    res = mbedtls_ecp_mul(grp, h, &x, &grp->G, rand_function, NULL);
    
    if (res != 0) {
        printf("Failed to generate h point: %d\n", res);
        return 1;
    }

    return 0;
}



int perform_enrollment(mbedtls_ecp_group *grp, mbedtls_ecp_point *h, mbedtls_ecp_point *C , const uint8_t *c1, size_t c1_size, const uint8_t *c2, size_t c2_size , 
                          PUF_Type *puf,
                          uint8_t *activation_code,
                          size_t activation_code_size,
                          const struct flash_area *flash_area,
                          const struct device *flash_dev,
                          bool writeToFlash){
    
    printf("Enrollement Started\r\n");

	mbedtls_mpi mpiValue_R1, mpiValue_R2;
	mbedtls_mpi_init(&mpiValue_R1);
	mbedtls_mpi_init(&mpiValue_R2);

	if (get_response_to_challenge(c1,c1_size,&mpiValue_R1,puf,activation_code,
                          activation_code_size,
                          flash_area,
                          flash_dev,
                          writeToFlash) != 0) {
		return 1;
	}

	if (get_response_to_challenge(c2,c2_size,&mpiValue_R2,puf,activation_code,  // Write to FLash always false since it is initialised in first call
                          activation_code_size,
                          flash_area,
                          flash_dev,
                          false) != 0) {
		return 1;
	}
    
	if(mbedtls_ecp_muladd(grp, C, &mpiValue_R1, &grp->G, &mpiValue_R2, h) != 0) { // C = g * R1 + h * R2
		return 1;
	}

	return 0;

}



int add_mul_mod(mbedtls_mpi *mpiValue_1, mbedtls_mpi *mpiValue_2,
		mbedtls_mpi *mpiValue_R, mbedtls_mpi *mpiValue_p, mbedtls_mpi *result) {

	if (mbedtls_mpi_mul_mpi(result, mpiValue_2, mpiValue_R) != 0) {
		return 1;
	}
	if (mbedtls_mpi_add_mpi(result, result, mpiValue_1) != 0) {
		return 1;
	}
	if (mbedtls_mpi_mod_mpi(result, result, mpiValue_p) != 0) {
		return 1;
	}
	return 0;
}





int perform_authentication(mbedtls_ecp_group *grp, mbedtls_ecp_point *g, mbedtls_ecp_point *h, 
                        mbedtls_ecp_point *proof, mbedtls_ecp_point *C, mbedtls_mpi *result_v, 
                        mbedtls_mpi *result_w, mbedtls_mpi *nonce,const uint8_t *c1, size_t c1_size, const uint8_t *c2, size_t c2_size , 
                          PUF_Type *puf,
                          uint8_t *activation_code,
                          size_t activation_code_size,
                          const struct flash_area *flash_area,
                          const struct device *flash_dev) {

	unsigned char sha256_result[32];
	int res = 0;
	mbedtls_mpi mpiValue_R1, mpiValue_R2, random_r, random_u, result_c;

	mbedtls_mpi_init(&mpiValue_R1);
	mbedtls_mpi_init(&mpiValue_R2);
	mbedtls_mpi_init(&random_r);
	mbedtls_mpi_init(&random_u);
	mbedtls_mpi_init(&result_c);
    
    if (!rng_initialized) {
        if (init_random_generator() != 0) {
            printf("Random generator init failed\n");
            return 1;
        }
    }



	if (generate_random_numbers(&random_r, &random_u) != 0) {
		printf("Error in Random Process\n\n");
		return 1;
	}

	if (get_response_to_challenge(c1,c1_size,&mpiValue_R1,puf,activation_code,
                          activation_code_size,
                          flash_area,
                          flash_dev,
                          false) != 0) {
		return 1;
	}

	if (get_response_to_challenge(c2,c2_size,&mpiValue_R2,puf,activation_code,  
                          activation_code_size,
                          flash_area,
                          flash_dev,
                          false) != 0) {
		return 1;
	}

	if(mbedtls_ecp_muladd(grp, proof, &random_r, g, &random_u, h) != 0) { //proof
		return 1;
	}

    unsigned char nonce_buf[32]; // 256-bit nonce
    res = mbedtls_ctr_drbg_random(&ctr_drbg, nonce_buf, sizeof(nonce_buf));
    if (res != 0) {
        printf("Error generating nonce\n");
        return 1;
    }

    res = mbedtls_mpi_read_binary(nonce, nonce_buf, sizeof(nonce_buf));
    if (res != 0) {
        printf("Error setting nonce\n");
        return 1;
    }

	size_t olen;
	unsigned char buff[100];
	mbedtls_ecp_point_write_binary(grp, C, MBEDTLS_ECP_PF_UNCOMPRESSED, &olen, buff, sizeof(buff));
	unsigned char buff2[olen + mbedtls_mpi_size(nonce)];
	memcpy(buff2, buff, olen);
	mbedtls_mpi_write_binary(nonce, buff2 + olen, sizeof(buff2) - olen);

	sha256_hash(buff2, sizeof(buff2), sha256_result);
    mbedtls_mpi_read_string(&result_c, 16, sha256_result);

	add_mul_mod(&random_r, &result_c, &mpiValue_R1, &grp->P, result_v);
	add_mul_mod(&random_u, &result_c, &mpiValue_R2, &grp->P, result_w);

	return 0;

}
```

## src/puf_prover.h
```c
#ifndef PUF_PROVER_H
#define PUF_PROVER_H

#include "fsl_puf.h"
#include "flash_handler.h"
#include "mbedtls/ecp.h"

#define NUM_RANDOM_NUMBERS 2
#define RANDOM_NUMBER_SIZE_BYTES 32
#define PUF_SLOT 0
#define CONSTANT_FOR_H_GENERATOR 123456789

/**
 * @brief Initializes and optionally enrolls and starts the PUF module.
 *
 * @param puf               Pointer to PUF instance.
 * @param pufConfig         PUF configuration structure.
 * @param activation_code   Buffer to store or read the activation code.
 * @param activation_code_size Size of the activation code buffer.
 * @param flash_area        Pointer to flash area for storing activation code.
 * @param flash_dev         Flash device used for read/write operations.
 * @param writeToFlash      Set to true for enrollment; false to reuse stored code.
 * @return 0 on success, non zero on failure.
 */
int initialize_and_start_puf(PUF_Type *puf, puf_config_t pufConfig,
                          uint8_t *activation_code, size_t activation_code_size,
                          const struct flash_area *flash_area,
                          const struct device *flash_dev, bool writeToFlash);

/**
* @brief Retrieves the PUF key and optionally stores the key code in flash.
*
* @param puf               Pointer to PUF instance.
* @param activation_code   Pointer to activation code buffer.
* @param activation_code_size Size of activation code.
* @param flash_area        Flash area for key code storage.
* @param flash_dev         Flash device.
* @param writeToFlash      True if key code should be written to flash.
* @param outputBuffer      Output buffer for the intrinsic key (optional).
* @return 0 on success, non zero on failure.
*/
int get_puf_key(PUF_Type *puf, uint8_t *activation_code, size_t activation_code_size,
              const struct flash_area *flash_area, const struct device *flash_dev,
              bool writeToFlash, uint8_t *outputBuffer);

/**
* @brief Deinitializes the PUF instance.
*
* @param puf           Pointer to PUF instance.
* @param pufConfig     PUF configuration structure.
*/
void puf_deinit(PUF_Type *puf, puf_config_t pufConfig);

/**
* @brief Computes the response from PUF for a given challenge.
*
* @param c             Input challenge.
* @param c_size        Size of the challenge.
* @param r             Output MPI result of the hashed response.
* @param puf           PUF instance.
* @param activation_code Activation code buffer.
* @param activation_code_size Activation code size.
* @param flash_area    Flash area used for key code.
* @param flash_dev     Flash device.
* @param writeToFlash  Whether to regenerate and store key code.
* @return 0 on success, non zero on failure.
*/
int get_response_to_challenge(const uint8_t *c, size_t c_size, mbedtls_mpi *r,
                            PUF_Type *puf, uint8_t *activation_code,
                            size_t activation_code_size,
                            const struct flash_area *flash_area,
                            const struct device *flash_dev, bool writeToFlash);

/**
* @brief Initializes ECC group and point h.
*
* @param grp           ECC group to initialize.
* @param h             ECC point h to compute.
* @param C             ECC point C to initialize.
* @return 0 on success, non zero on failure.
*/
int init_ECC(mbedtls_ecp_group *grp, mbedtls_ecp_point *h, mbedtls_ecp_point *C);

/**
* @brief Performs ECC enrollment operation with two challenges and stores resulting point C.
*
* @param grp           ECC group.
* @param h             Precomputed ECC point h.
* @param C             Output ECC commitment point C.
* @param c1, c2        Challenge 1 and 2 buffers.
* @param c1_size, c2_size Size of challenge buffers.
* @param puf           PUF instance.
* @param activation_code Activation code.
* @param activation_code_size Size of activation code.
* @param flash_area    Flash area used.
* @param flash_dev     Flash device.
* @param writeToFlash  Whether to store new key code.
* @return 0 on success, non zero on failure.
*/
int perform_enrollment(mbedtls_ecp_group *grp, mbedtls_ecp_point *h, mbedtls_ecp_point *C,
                      const uint8_t *c1, size_t c1_size,
                      const uint8_t *c2, size_t c2_size,
                      PUF_Type *puf, uint8_t *activation_code,
                      size_t activation_code_size,
                      const struct flash_area *flash_area,
                      const struct device *flash_dev, bool writeToFlash);

/**
* @brief Adds and multiplies values modulo a given prime.
*
* @param mpiValue_1    Value to add.
* @param mpiValue_2    Value to multiply.
* @param mpiValue_R    Second value to multiply.
* @param mpiValue_p    Modulo value (usually EC group prime).
* @param result        Output result.
* @return 0 on success, non zero on error.
*/
int add_mul_mod(mbedtls_mpi *mpiValue_1, mbedtls_mpi *mpiValue_2,
                mbedtls_mpi *mpiValue_R, mbedtls_mpi *mpiValue_p,
                mbedtls_mpi *result);



/**
* @brief Performs PUF-based ECC authentication and response proof generation.
*
* @param grp           ECC group.
* @param g             Generator point g.
* @param h             Secondary generator point h.
* @param proof         Output ECC proof point.
* @param C             Commitment point.
* @param result_v      Output response scalar v.
* @param result_w      Output response scalar w.
* @param nonce         Output nonce used in hashing.
* @param c1, c2        Challenges used for authentication.
* @param c1_size, c2_size Sizes of challenges.
* @param puf           PUF instance.
* @param activation_code Activation code buffer.
* @param activation_code_size Size of activation code.
* @param flash_area    Flash area used for flash reads.
* @param flash_dev     Flash device used.
* @return 0 on success, non zero on failure.
*/
int perform_authentication(mbedtls_ecp_group *grp, mbedtls_ecp_point *g, mbedtls_ecp_point *h,
                          mbedtls_ecp_point *proof, mbedtls_ecp_point *C,
                          mbedtls_mpi *result_v, mbedtls_mpi *result_w,
                          mbedtls_mpi *nonce,
                          const uint8_t *c1, size_t c1_size,
                          const uint8_t *c2, size_t c2_size,
                          PUF_Type *puf, uint8_t *activation_code,
                          size_t activation_code_size,
                          const struct flash_area *flash_area,
                          const struct device *flash_dev);


#endif /* PUF_PROVER_H */
```

## src/utils.c
```c
#include <stdio.h>
#include "mbedtls/ctr_drbg.h"
#include "mbedtls/entropy.h"
#include "mbedtls/ecp.h"
#include "utils.h"

void sha256Hash(const unsigned char *data, size_t data_len,
    unsigned char *output) {
    mbedtls_sha256(data, data_len, output, 0);
}

int randFunction(void *rng_state, unsigned char *output, size_t len) {

    size_t use_len;
	int rnd;
    
	if (rng_state != NULL)
		rng_state = NULL;

	while (len > 0) {
		use_len = len;
		if (use_len > sizeof(int))
			use_len = sizeof(int);

		rnd = rand();
		memcpy(output, &rnd, use_len);
		output += use_len;
		len -= use_len;
	}

    
	return (0);
}


size_t exportCommitment(mbedtls_ecp_group *grp,const mbedtls_ecp_point *C, uint8_t *buf, size_t buf_size) {

    size_t olen;
	int ret = mbedtls_ecp_point_write_binary(grp, C, MBEDTLS_ECP_PF_UNCOMPRESSED, &olen, buf, buf_size);

    return (ret == 0) ? olen : -1;
}

int importCommitment(mbedtls_ecp_group *grp,const uint8_t *buf, mbedtls_ecp_point *P) {
    int ret = mbedtls_ecp_point_read_binary(grp, P, buf, 65); // 65 bytes for uncompressed point
    return ret;
}

int generateRandomNumbers(mbedtls_mpi *num, mbedtls_mpi *num2) {
    if (!rng_initialized) {
        if (init_random_generator() != 0) {
            return 1;
        }
    }

    unsigned char randomBytes[64]; // 2x 32 bytes

    if (mbedtls_ctr_drbg_random(&ctr_drbg, randomBytes, sizeof(randomBytes)) != 0) {
        return 1;
    }

    if (mbedtls_mpi_read_binary(num, randomBytes, 32) != 0) {
        return 1;
    }
    if (mbedtls_mpi_read_binary(num2, randomBytes + 32, 32) != 0) {
        return 1;
    }

    return 0;
}

void print_mpi(const char *label, const mbedtls_mpi *value) {
    char buf[100];
    size_t olen;
    if (mbedtls_mpi_write_string(value, 16, buf, sizeof(buf), &olen) == 0) {
        printf("%s = %s\n", label, buf);
    } else {
        printf("Failed to print %s\n", label);
    }
}


void print_ecp_point(const char *label, const mbedtls_ecp_group *grp, const mbedtls_ecp_point *point) {

    unsigned char buf[100];
    size_t olen;

    if (mbedtls_ecp_point_write_binary(grp, point,
            MBEDTLS_ECP_PF_UNCOMPRESSED, &olen, buf, sizeof(buf)) == 0)
    {
        printf("%s = ", label);
        for (size_t i = 0; i < olen; i++) {
            printf("%02X", buf[i]);
        }
        printf("\n");
    } else {
        printf("Failed to print %s (EC point)\n", label);
    }
}

int init_random_generator() {
    const char *pers = "nonce_gen";
    mbedtls_entropy_init(&entropy);
    mbedtls_ctr_drbg_init(&ctr_drbg);

    if (mbedtls_ctr_drbg_seed(&ctr_drbg, mbedtls_entropy_func, &entropy,
                               (const unsigned char *)pers, strlen(pers)) != 0) {
        printf("Failed to seed random generator\n");
        return -1;
    }
    rng_initialized = 1;
    return 0;
}

int hex_string_to_bytes(const char *hex, uint8_t *out, size_t out_size) {
    size_t len = strlen(hex);
    if (len % 2 != 0 || len / 2 > out_size) {
        return -1; // Invalid length or buffer size too small
    }

    for (size_t i = 0; i < len / 2; i++) {
        sscanf(hex + 2 * i, "%2hhx", &out[i]); // Read two characters as one byte
    }
    return 0; // Success
}
```

## src/utils.h
```c
#ifndef UTILS_H
#define UTILS_H

#include <stdint.h>
#include <stddef.h>
#include "mbedtls/ecp.h"
#include "mbedtls/sha256.h"
#include "mbedtls/ctr_drbg.h"
#include "mbedtls/entropy.h"

#ifdef __cplusplus
extern "C" {
#endif

static mbedtls_entropy_context entropy;
static mbedtls_ctr_drbg_context ctr_drbg;
static int rng_initialized = 0;

/**
 * @brief Computes SHA-256 hash of input data.
 *
 * @param data       Pointer to input data.
 * @param data_len   Length of input data.
 * @param output     Output buffer (32 bytes) for SHA-256 hash.
 */
void sha256Hash(const unsigned char *data, size_t data_len, unsigned char *output);

/**
 * @brief Simple fallback random number generator using rand().
 *
 * @param rng_state  Unused parameter (can be NULL).
 * @param output     Buffer to store generated random bytes.
 * @param len        Number of random bytes to generate.
 * @return 0 on success.
 */
int randFunction(void *rng_state, unsigned char *output, size_t len);

/**
 * @brief Serializes an EC point to a buffer.
 *
 * @param grp        EC group the point belongs to.
 * @param C          EC point to serialize.
 * @param buf        Buffer to write the serialized point.
 * @param buf_size   Size of the buffer.
 * @return Number of bytes written on success, -1 on failure.
 */
size_t exportCommitment(mbedtls_ecp_group *grp, const mbedtls_ecp_point *C, uint8_t *buf, size_t buf_size);

/**
 * @brief Deserializes an EC point from a buffer.
 *
 * @param grp        EC group to read the point into.
 * @param buf        Buffer containing the serialized EC point (65 bytes expected).
 * @param P          Destination EC point.
 * @return length on success, -1 on failure.
 */
int importCommitment(mbedtls_ecp_group *grp, const uint8_t *buf, mbedtls_ecp_point *P);

/**
 * @brief Generates two random 256-bit (32-byte) numbers using CTR_DRBG.
 *
 * @param num        Output MPI for the first random number.
 * @param num2       Output MPI for the second random number.
 * @return 0 on success, 1 on error.
 */
int generateRandomNumbers(mbedtls_mpi *num, mbedtls_mpi *num2);

/**
 * @brief Prints a big number (MPI) in hexadecimal.
 *
 * @param label      Label to print before the number.
 * @param value      MPI value to print.
 */
void print_mpi(const char *label, const mbedtls_mpi *value);

/**
 * @brief Prints an EC point in uncompressed hexadecimal form.
 *
 * @param label      Label to print before the point.
 * @param grp        EC group the point belongs to.
 * @param point      EC point to print.
 */
void print_ecp_point(const char *label, const mbedtls_ecp_group *grp, const mbedtls_ecp_point *point);

/**
 * @brief Initializes the global CTR_DRBG context for secure random number generation.
 *
 * This must be called once at startup before using generateRandomNumbers().
 *
 * @return 0 on success, non-zero on error.
 */
int init_random_generator(void);

/**
 * @brief Converts a hexadecimal string to a byte array.
 *
 * @param hex       Null-terminated string containing hexadecimal characters.
 * @param out       Output buffer where the bytes will be stored.
 * @param out_size  Size of the output buffer.
 * @return int      0 on success, non zero on failure
 */
int hex_string_to_bytes(const char *hex, uint8_t *out, size_t out_size);

#ifdef __cplusplus
}
#endif

#endif // UTILS_H
```
