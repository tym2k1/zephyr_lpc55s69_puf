## CMakeLists.txt
```
# SPDX-License-Identifier: Apache-2.0

cmake_minimum_required(VERSION 3.20.0)

find_package(Zephyr REQUIRED HINTS $ENV{ZEPHYR_BASE})
project(hello_world)

target_sources(app PRIVATE src/main.c src/puf_prover.c)

# Include the fsl_puf driver in HAL_NXP
set(PUF_path $ENV{ZEPHYR_BASE}/../modules/hal/nxp/mcux/mcux-sdk/drivers/puf)
zephyr_sources(${PUF_path}/fsl_puf.c)
zephyr_include_directories(${PUF_path})
```

## prj.conf
```kconfig
CONFIG_MAIN_STACK_SIZE=8192
CONFIG_FLASH_MAP=y
CONFIG_NVS=y
CONFIG_FLASH=y
CONFIG_MPU_ALLOW_FLASH_WRITE=y
```

## src/main.c
```c
#include <stdio.h>
#include "flash_handler.h"
#include "puf_prover.h"

#define IS_WRITE_TO_FLASH_ENABLED 1

int main(void)
{
    __attribute__((aligned(16))) uint8_t activation_code[PUF_ACTIVATION_CODE_SIZE];

    const struct flash_area *flash_area;
    const struct device *flash_dev;
    int ret;

    /* Initialize flash area and device */
    ret = flash_initialize(FIXED_PARTITION_ID(STORAGE_PARTITION), &flash_area, &flash_dev);
    if (ret != 0) {
        printf("Flash Initialization failed!\r\n");
        return ret;
    }

    ret = PUF_Prover_Initialize(PUF,
                                    activation_code,
                                    PUF_ACTIVATION_CODE_SIZE,
                                    flash_area,
                                    flash_dev,
                                    IS_WRITE_TO_FLASH_ENABLED);
    if (ret != 0) {
        printf("PUF Prover Initialization failed!\r\n");
        return ret;
    }

    return 0;
}
```

## src/flash_handler.c
```c
#include "flash_handler.h"
#include <stdio.h>
#include <stdlib.h>
#include <string.h>

int flash_initialize(uint32_t partition_id, const struct flash_area **flash_area_out, const struct device **flash_dev_out)
{
    int ret;
    const struct flash_area *flash_area;

    ret = flash_area_open(partition_id, &flash_area);
    if (ret != 0) {
        printf("Error: Failed to open storage partition\r\n");
        return -1;
    }

    if (!flash_area_has_driver(flash_area)) {
        printf("Error: Flash area has no driver!\r\n");
        flash_area_close(flash_area);
        return -1;
    }

    const struct device *flash_dev = flash_area_get_device(flash_area);
    if (!device_is_ready(flash_dev)) {
        printf("Error: Flash device is not ready!\r\n");
        flash_area_close(flash_area);
        return -1;
    }

    *flash_area_out = flash_area;
    *flash_dev_out = flash_dev;
    return 0;
}

int flash_write_padded(const struct device *flash_dev, const struct flash_area *flash_area, off_t data_offset,
                       const uint8_t *data, size_t data_size)
{
    int ret;
    size_t aligned_size = ALIGN_UP(data_size, FLASH_WRITE_SIZE);
    off_t absolute_offset = flash_area->fa_off + data_offset;
    uint8_t *padded_buf = malloc(aligned_size);
    if (!padded_buf) {
        printf("Error: Unable to allocate memory for padded buffer.\r\n");
        return -1;
    }
    /* Fill with flash default erased state (commonly 0xFF) */
    memset(padded_buf, 0xFF, aligned_size);

    /* Copy the provided data into padded buffer */
    memcpy(padded_buf, data, data_size);

    /* Erase the flash region */
    ret = flash_erase(flash_dev, absolute_offset, aligned_size);
    if (ret != 0) {
        printf("Error: Flash erase failed! (rc %d)\r\n", ret);
        free(padded_buf);
        return -1;
    }

    /* Write the padded data to flash */
    ret = flash_write(flash_dev, absolute_offset, padded_buf, aligned_size);
    if (ret != 0) {
        printf("Error: Flash write failed! (rc %d)\r\n", ret);
        free(padded_buf);
        return -1;
    }

    free(padded_buf);
    return 0;
}

int flash_read_data(const struct device *flash_dev, const struct flash_area *flash_area, off_t data_offset,
                    uint8_t *buffer, size_t data_size)
{
    int ret;
    size_t aligned_size = ALIGN_UP(data_size, FLASH_WRITE_SIZE);
    off_t absolute_offset = flash_area->fa_off + data_offset;
    uint8_t *padded_buf = malloc(aligned_size);
    if (!padded_buf) {
        printf("Error: Unable to allocate memory for padded buffer.\r\n");
        return -1;
    }

    ret = flash_read(flash_dev, absolute_offset, padded_buf, aligned_size);
    if (ret != 0) {
        printf("Error: Flash read failed! (rc %d)\r\n", ret);
        free(padded_buf);
        return -1;
    }

    /* Copy only the actual data portion */
    memcpy(buffer, padded_buf, data_size);
    free(padded_buf);
    return 0;
}
```

## src/flash_handler.h
```c
#include <zephyr/drivers/flash.h>
#include <zephyr/storage/flash_map.h>

/* Flash configuration macros, specific to
 * platform/use-case. These were based
 * on the LPC55S69 board */

#ifndef FLASH_WRITE_SIZE
#define FLASH_WRITE_SIZE  0x200 /* 512 bytes as per DTS */
#endif
#ifndef PARTITION_OFFSET
#define PARTITION_OFFSET  0     /* Offset within the partition */
#endif
#ifndef STORAGE_PARTITION
#define STORAGE_PARTITION storage_partition
#endif

/* Define flash layout offsets within the partition */
#define FLASH_OFFSET_ACTIVATION_CODE (PARTITION_OFFSET + 0)
#define FLASH_SIZE_ACTIVATION_CODE   ALIGN_UP(PUF_ACTIVATION_CODE_SIZE, FLASH_WRITE_SIZE)

/* Later additional variables can be tracked as needed, for example:
 * #define FLASH_OFFSET_ADDITIONAL_VAR (FLASH_OFFSET_ACTIVATION_CODE + FLASH_SIZE_ACTIVATION_CODE)
 * #define FLASH_SIZE_ADDITIONAL_VAR   0x400
 */

/* Macro to align size up to the next multiple of 'align' */
#define ALIGN_UP(x, align) (((x) + (align) - 1) & ~((align) - 1))

/**
 * @brief Initializes the flash area and returns the flash device pointer.
 *
 * @param partition_id   Identifier for the flash partition.
 * @param flash_area_out Pointer to the flash_area pointer to be filled.
 * @param flash_dev_out  Pointer to the flash device pointer to be filled.
 *
 * @return 0 on success, -1 on error.
 */
int flash_initialize(uint32_t partition_id, const struct flash_area **flash_area_out, const struct device **flash_dev_out);

/**
 * @brief Writes data to flash with page-size alignment.
 *
 * @param flash_dev       Pointer to the flash device.
 * @param flash_area      Pointer to the flash area structure.
 * @param data_offset     Data starting point offset within the partition.
 * @param data            Pointer to the data to be written.
 * @param data_size       Size of the data.
 *
 * @return 0 on success, -1 on error.
 */
int flash_write_padded(const struct device *flash_dev, const struct flash_area *flash_area, off_t data_offset,
                       const uint8_t *data, size_t data_size);

/**
 * @brief Reads data from flash into a provided buffer.
 *
 * @param flash_dev       Pointer to the flash device.
 * @param flash_area      Pointer to the flash area structure.
 * @param data_offset     Data starting point offset within the partition.
 * @param buffer          Destination buffer for read data.
 * @param data_size       Size of the data to read.
 *
 * @return 0 on success, -1 on error.
 */
int flash_read_data(const struct device *flash_dev, const struct flash_area *flash_area, off_t data_offset,
                    uint8_t *buffer, size_t data_size);
```

## src/puf_prover.c
```c
#include <stdio.h>
#include "puf_prover.h"
#include "flash_handler.h"

int PUF_Prover_Initialize(PUF_Type *puf,
                          uint8_t *activation_code,
                          size_t activation_code_size,
                          const struct flash_area *flash_area,
                          const struct device *flash_dev,
                          bool writeToFlash)
{
    status_t status;
    puf_config_t pufConfig;
    int err;

    /* Get default configuration and initialize the provided PUF instance */
    PUF_GetDefaultConfig(&pufConfig);
    status = PUF_Init(puf, &pufConfig);
    if (status != kStatus_Success) {
        printf("Error: PUF initialization failed!\r\n");
        return -1;
    }
    printf("PUF Initialized Successfully.\r\n");

    if (writeToFlash) {
        /* Enroll and generate the activation code */
        memset(activation_code, 0, activation_code_size);
        status = PUF_Enroll(puf, activation_code, activation_code_size);
        if (status != kStatus_Success) {
            printf("Error: PUF enrollment failed!\r\n");
            flash_area_close(flash_area);
            return -1;
        }
        printf("PUF Enroll successful. Activation Code created.\r\n");

        /* Write the activation code to flash with padding */
        err = flash_write_padded(flash_dev, flash_area, FLASH_OFFSET_ACTIVATION_CODE,
                                 activation_code, activation_code_size);
        if (err != 0) {
            flash_area_close(flash_area);
            return -1;
        }
        printf("Activation code saved in flash.\r\n");

        /* Reinitialize PUF after enrollment */
        PUF_Deinit(puf, &pufConfig);
        PUF_Init(puf, &pufConfig);
        printf("PUF Reinitialized after enrollment.\r\n");
    } else {
        /* Read the activation code from flash */
        err = flash_read_data(flash_dev, flash_area, FLASH_OFFSET_ACTIVATION_CODE,
                              activation_code, activation_code_size);
        if (err != 0) {
            flash_area_close(flash_area);
            return -1;
        }
        printf("Activation code read from flash.\r\n");
    }

    /* Start the PUF with the activation code */
    status = PUF_Start(puf, activation_code, activation_code_size);
    if (status != kStatus_Success) {
        printf("Error: PUF start failed!\r\n");
        return -1;
    }
    printf("PUF Started successfully.\r\n");

    uint8_t keyCode[PUF_KEY_CODE_SIZE] = {0};
    uint8_t intrinsicKey[PUF_KEY_SIZE] = {0};

    if (writeToFlash) {

        err = PUF_SetIntrinsicKey(PUF, kPUF_KeyIndex_01, PUF_KEY_SIZE, keyCode, sizeof(keyCode));
        if (err != 0) {
            printf("PUF Intrinsic key 1 generation failed!\r\n");
            return err;
        }

        err = flash_write_padded(flash_dev, flash_area, FLASH_OFFSET_INTRINSIC_KEY_1_KC,
                                 keyCode, PUF_KEY_CODE_SIZE);
        if (err != 0) {
            printf("PUF Intrinsic key 1 KC saving to flash failed!\r\n");
            return err;

        }
    } else {
        err = flash_read_data(flash_dev, flash_area, FLASH_OFFSET_INTRINSIC_KEY_1_KC,
                              keyCode, PUF_KEY_CODE_SIZE);
        if (err != 0) {
            flash_area_close(flash_area);
            return -1;
        }
        printf("Intrinsic key code read from flash.\r\n");
    }

    printf("Intrinsic key code = \r\n");
    for (int i = 0; i < PUF_KEY_CODE_SIZE; i++)
    {
        printf("%x ", keyCode[i]);
    }
    printf("\r\n");
    /* Reconstruct intrinsic key from keyCode1 generated by PUF_SetIntrinsicKey() */
    err = PUF_GetKey(PUF, keyCode, sizeof(keyCode), intrinsicKey, sizeof(intrinsicKey));
    if (err != kStatus_Success)
    {
        printf("Error reconstructing intrinsic key!\r\n");
    }

    printf("Reconstructed intrinsic key = ");
    for (int i = 0; i < PUF_KEY_SIZE; i++)
    {
        printf("%x ", intrinsicKey[i]);
    }
    printf("\r\n");

    flash_area_close(flash_area);

    return 0;
}
```

## src/puf_prover.h
```c
#ifndef PUF_PROVER_H
#define PUF_PROVER_H

#include "fsl_puf.h"
#include "flash_handler.h"

/**
 * @brief Initialize the PUF prover.
 *
 * This function initializes the PUF Prover logic and then
 * either enrolls and saves the activation code to flash (if writeToFlash is true)
 * or reads the activation code from flash.
 *
 * @param puf                  Pointer to the PUF instance.
 * @param activation_code      Buffer where the activation code will be stored.
 * @param activation_code_size Size of the activation code in bytes.
 * @param writeToFlash         True to enroll and write the activation code,
 *                             false to read it from flash.
 *
 * @return 0 on success, negative error code on failure.
 */
int PUF_Prover_Initialize(PUF_Type *puf,
                          uint8_t *activation_code,
                          size_t activation_code_size,
                          bool writeToFlash);

#endif /* PUF_PROVER_H */
```
